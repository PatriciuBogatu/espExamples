## main/Kconfig.projbuild
```kconfig
menu "Application settings"

    choice PROV_METHOD
        prompt "Provisioning method"
        default PROV_METHOD_SOFTAP
        help
            Provisioning method to add a WiFi network
        config PROV_METHOD_SOFTAP
            bool "softap"
        config PROV_METHOD_BLE
            bool "ble"
    endchoice
    
    config PROV_METHOD
        int
        default 1 if PROV_METHOD_BLE
        default 0

    config MQTT_BROKER_IP
        string "IP of the MQTT broker to connect to"
        default "192.168.236.200"
        help
            The local network IP of the machine where you run MQTT broker

    config MQTT_PORT
        int "Port of the MQTT broker in use"
        default 8089
        help
            In general, port 1883 is for plaintext MQTT connections (no encryption).

    config MQTT_CLIENT_IDENTIFIER
        string "The MQTT client identifier used in this example"
        default "bme-0"
        help
            The MQTT client identifier used in this example. Each client identifier must be unique.

    config REST_SERVER_IP
        string "The IP of the REST server."
        default "192.168.236.200"
    
    config REST_SERVER_PORT
        string "The port of the REST server."
        default 5000
    
endmenu
```

## sdkconfig.defaults
```kconfig
## LVGL8 ##
CONFIG_LV_USE_PERF_MONITOR=y
CONFIG_LV_COLOR_16_SWAP=y
CONFIG_LV_MEM_CUSTOM=y
CONFIG_LV_MEMCPY_MEMSET_STD=y


#CLIB default
CONFIG_LV_USE_CLIB_MALLOC=y
CONFIG_LV_USE_CLIB_SPRINTF=y
CONFIG_LV_USE_CLIB_STRING=y

# Performance monitor
CONFIG_LV_USE_OBSERVER=y
CONFIG_LV_USE_SYSMON=y
CONFIG_LV_USE_PERF_MONITOR=y


CONFIG_I2C_LEGACY_DRIVER_ENABLED=y
CONFIG_I2C_DRIVER_NEW=n

CONFIG_FREERTOS_TIMER_TASK_STACK_DEPTH=3120
CONFIG_BT_ENABLED=y
CONFIG_BTDM_CTRL_MODE_BLE_ONLY=y
CONFIG_BT_NIMBLE_ENABLED=y

CONFIG_PARTITION_TABLE_CUSTOM=y
CONFIG_PARTITION_TABLE_CUSTOM_FILENAME="partitions.csv"
CONFIG_PARTITION_TABLE_FILENAME="partitions.csv"
CONFIG_PARTITION_TABLE_OFFSET=0x8000
CONFIG_PARTITION_TABLE_MD5=y

CONFIG_MBEDTLS_DYNAMIC_BUFFER=y
CONFIG_MBEDTLS_DYNAMIC_FREE_PEER_CERT=y
CONFIG_MBEDTLS_DYNAMIC_FREE_CONFIG_DATA=y
CONFIG_MBEDTLS_CERTIFICATE_BUNDLE_DEFAULT_CMN=y

CONFIG_ESP_INSIGHTS_ENABLED=y
# Has no effect on its own, you have to change in menuconfig the transport to MQTT, add property here later
CONFIG_ESP_INSIGHTS_CMD_RESP_ENABLED=y
CONFIG_ESP_RMAKER_DEF_TIMEZONE="Europe/Bucharest"
```
